OUTPUT_FORMAT("binary")
ENTRY(kernel_entry)

SECTIONS {
    . = 0x1000;

    .text : {
        *(.text.entry)
        *(.text*)
    }

    .rodata : {
        *(.rodata*)
    }

    .data : {
        *(.data*)
    }

    .bss : {
        *(.bss*)
        *(COMMON)
    }
}
